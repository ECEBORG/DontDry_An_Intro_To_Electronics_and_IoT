/*Bonjour et bienvenue sur le code du projet don't dry, tout est commenté et vous pouvez retrouver toutes les recherches du projet sur le git d'eceborg: https://github.com/ECEBORG
Ce code a été réalisé par Nicolas Chollet en Décembre 2019*/


/* Librairies à inclure pour le fonctionnement du projet*/
#include <Adafruit_SSD1306.h> //Bibliothèque de fonctions pour l'écran Oled 128x64
#include <DHT.h> //Bibliothèque de fonctions pour le capteur de température et d'humidité DT11
#include <NTPClient.h> //Bibliothèque de fonction pour la récupération de l'heure sur un serveur NTP
#include <ESP8266WiFi.h> //Bibliothèque de fonction pour la connexion à internet
#include <WiFiUdp.h>  //Bibliothèque de fonction pour la connexion à internet
#include <WiFiClient.h>  //Bibliothèque de fonction pour la connexion à internet
#include <ESP8266WebServer.h>  //Bibliothèque de fonction pour la connexion à internet

/*Ci dessous les Bitmaps: PAS DE PANIQUE il s'agit juste des images logo de l'ECE Paris et d'ECEborg. Si vous voulez changez ou rajouter des images le tutoriel à suivre: https://projetsdiy.fr/ssd1306-mini-ecran-oled-i2c-128x64-arduino/ */

const unsigned char bitmap_ECEBORG[] PROGMEM = {
  B11111111,B11111111,B11111111,B11111111,B11111111,B11111111,B11111111,B11111111,B11111111,B11111111,B11111111,B11111111,B11111111,B11111111,B11111111,B11111111, // ################################################################################################################################
  B11111111,B11111111,B11111111,B11111111,B11111111,B11111111,B11111111,B11111111,B11111111,B11111111,B11111111,B11111111,B11111111,B11111111,B11111111,B11111111, // ################################################################################################################################
  B11111111,B11111111,B11111111,B11111111,B11111111,B11111111,B11111111,B11111111,B11111111,B11111111,B11111111,B11111111,B11111111,B11111111,B11111111,B11111111, // ################################################################################################################################
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  B11111111,B11111111,B11111111,B11111111,B11111111,B11111111,B11111111,B11111111,B11111111,B11111111,B11111111,B11111111,B11111111,B11111111,B11111111,B11111111  // ################################################################################################################################
};


const unsigned char bitmap_ECE[] PROGMEM = {
  B00000000,B00000000,B00000000,B00000000,B00000000,B00000000,B00000000,B00000000,B00000000,B00000000,B00000000,B00000000,B00000000,B00000000,B00000000,B00000000, // ................................................................................................................................
  B00000000,B00000000,B00000000,B00000000,B00000011,B11111111,B11111111,B11111111,B11111111,B11111111,B11111111,B11110000,B00000000,B00000000,B00000000,B00000000, // ......................................######################################################....................................
  B00000000,B00000000,B00000000,B00000000,B00000111,B11111111,B11111111,B11111111,B11111111,B11111111,B11111111,B11110000,B00000000,B00000000,B00000000,B00000000, // .....................................#######################################################....................................
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  B00000000,B00000000,B00000000,B00000000,B00000000,B00000000,B00000000,B00000000,B00000000,B00000000,B00000000,B00000000,B00000000,B00000000,B00000000,B00000000  // ................................................................................................................................
};


#define SCREEN_WIDTH 128 // OLED display largeur en pixels
#define SCREEN_HEIGHT 64 // OLED display hauteur en pixels

/* Declaration des variables pour l'écran OLED*/

#define OLED_RESET     0 // Reset pin # (or -1 if sharing Arduino reset pin)
Adafruit_SSD1306 display(SCREEN_WIDTH, SCREEN_HEIGHT, &Wire, OLED_RESET);

/*Declaration des variables pour le capteur d'humidité et température DHT 11*/

#define DHTPIN D4
#define DHTTYPE DHT11 
DHT dht(DHTPIN, DHTTYPE);

/*Declarattion des variables pour la Wifi*/
const long utcOffsetInSeconds = 3600; //gestion de l'heure
WiFiUDP ntpUDP; //gestion de l'heure
NTPClient timeClient(ntpUDP, "pool.ntp.org", utcOffsetInSeconds);//gestion de l'heure
int connection=0;//gestion de l'heure
/**********************************************************************************************/
/*ICI CHANGER LE MOT DE PASSE WIFI SELON VOS BESOINS*/
const char *ssid     = "LE NOM DE VOTRE WIFI";
const char *password = "LE MOT DE PASSE DE VOTRE WIFI";
/**********************************************************************************************/
ESP8266WebServer server ( 80 ); //initialisation du serveur

/* Déclaration des variables pour les capteurs*/
float h=0;
float t=0;
int soilValue=0;




/* Page qui s'affiche lorsqu'on tape va sur l'adresse IP indiqué sur l'écran lors de l'initialisation si les deux machines sont sur le même réseau*/

String getPage(){
  String page = "<html lang=fr-FR><head><meta http-equiv='refresh' content='10'/>";
  page += "<title>ECE Paris Don't Dry</title>";
  page += "<style> body { background-color: #fffff; font-family: Arial, Helvetica, Sans-Serif; Color: #000088; }</style>";
  page += "</head><body><h1>ECE Paris - Don't Dry</h1>";
  page += "<h3>Climat:</h3>";
  page += "<ul><li>Temperature : ";
  page += t;
  page += "C</li>";
  page += "<li>Humidite : ";
  page += h;
  page += "%</li></ul><h3>Plante</h3>";
  page += "<ul><li>Etat du sol : ";
  page += soilValue;
  page += " inférieur à 600 vous devez arroser</li></ul>";
  page += "</body></html>";
  return page;
}
/*Fonction pour accepter les clients sur le serveur*/
void handleRoot(){ 
  server.send ( 200, "text/html", getPage() );
}



/*Fonction d'initialisation qui s'exécute une fois au début du code*/
void setup() {
  
 Serial.begin(9600);

  // SSD1306_SWITCHCAPVCC = generate display voltage from 3.3V internally
  if(!display.begin(SSD1306_SWITCHCAPVCC, 0x3C)) { // Address 0x3D for 128x64
    Serial.println(F("SSD1306 allocation failed"));
    for(;;); // Don't proceed, loop forever
  }

  // à changer uniquement pour changer l'orientation du texte sur l'écran : display.setRotation(2);
  
  display.clearDisplay();
  
  /*Affichae du bitmap ECE et Eceborg*/
  display.drawBitmap(0,0,bitmap_ECE,128,64,WHITE);
  display.display();
  delay(3000); 
  display.clearDisplay();
  display.drawBitmap(0,0,bitmap_ECEBORG,128,64,WHITE);
  display.invertDisplay(1);
  display.display();
  delay(2000); 
  /*Affichage du nom de la personne!*/
  display.clearDisplay();
  display.invertDisplay(0);
  display.setTextSize(2);
  display.setTextColor(WHITE);
  display.setCursor(0,0);
  display.println(" ");
  /****************************/
  /*Texte d'acceuil a définir*/
  display.println("Bonjour");
  display.println("Jedi");
  /****************************/
  display.display();
  delay(2000);
  Serial.begin(115200);

 /*Connextion à la Wifi*/
 WiFi.begin(ssid, password);

  do 
  {
   if ( WiFi.status() != WL_CONNECTED){
   Serial.println("...");
   connection++;
   delay(500);}
   else {connection=20;}
  }while(connection<20);

   display.clearDisplay();
   display.invertDisplay(0);
   display.setTextSize(2);
   display.setTextColor(WHITE);

   /*Si on est en mode hors ligne on le dit*/
  if(WiFi.status() != WL_CONNECTED){
    display.clearDisplay();
    display.setCursor(0,0);
    display.println(" WiFi Off");
    display.println("   Mode");
    display.println("Hors ligne");
    display.display();
    delay(2000);
    }

    /*Si on est en mode en ligne on affiche l'IP*/
  else{
    server.on ( "/", handleRoot );
    server.begin();
    display.clearDisplay();
    display.setCursor(2,0);
    display.println(" Wifi On");
    display.println("Votre IP :");
    display.print(WiFi.localIP());
    display.display();
    delay(4000);
    }
/*Initialisation du capteur de température et d'humidité*/
 dht.begin();
 
  }




void loop() {
/*Si une requete arrive il affiche la page*/
server.handleClient();
  
  display.clearDisplay();
  display.setTextSize(2);
  display.setTextColor(WHITE);
  display.setCursor(0,0);

  /*Lecture des valeurs */
  h = dht.readHumidity();
  t = dht.readTemperature();
  // t=t-3;
  
 
  /*Si on arrive pas à lire le DHT 11
  if (isnan(h) || isnan(t)) {
    display.println("Failed to read from DHT sensor!");
    display.display();
    display.clearDisplay();
    return;
  }*/

  /*Lecture de la valeur du sol et affichage en serial*/
  soilValue = analogRead(A0);
  Serial.println(soilValue);

  
/*On affiche les valeurs */
  display.print(" T:");
  display.print(t);
  display.println(" C");
  // Humidité en % - Humidity in % 
  display.print(" H:");
  display.print(h);
  display.println(" %");
  display.print("Soil: ");
  
  /************************************/
  /*Ici il faut potentiellement ajuster les valeurs pour adapter au pot de la plante: les valeurs vont de 0 à 1024 plus la valeur est haute plus le sol est sec
  Il faut choisir deux valeurs: la valeurs à laquelle le capteur nous dit d'arroser et la valeur a laquelle le sol est trop mouillé*/
  if(soilValue>800){display.print("HELP");}
  else if(soilValue>=100){display.print(" OK");}
  else if(soilValue<100){display.print(" Wet");}
  /****************************/

/*Affichage de l'heure si connecté à la wifi*/
   if(WiFi.status() == WL_CONNECTED){
    timeClient.update();
    display.print("   ");
    if(timeClient.getHours()<10){display.print("0");}
    display.print(timeClient.getHours());
    display.print(":");
    if(timeClient.getMinutes()<10){display.print("0");}
    display.println(timeClient.getMinutes());
   }
  
  display.display();

  /*Délais entre deux relevé*/
  delay(1000);
  
}
  
